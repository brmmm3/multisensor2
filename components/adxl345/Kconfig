## components/adxl345/Kconfig
```kconfig
menu "ADXL345 Options"
    config ADXL345_I2C_CLK_SPEED_HZ
        int "I2C Clock Speed (Hz)"
        default 100000
        range 1000 100000
        help
            Set the I2C clock speed in Hz. Only applies to the new I2C Master driver.

    config ADXL345_PROBE_TIMEOUT
        int "Probe Timeout"
        default 500
        help
            Number of ticks to wait for I2C probe operation.
        
    config ADXL345_TIMEOUT
        int "Read/Write Timeout"
        default 50
        help
            Number of ticks to wait for I2C read/write operations.
endmenu
```

## components/qmc5883l/Kconfig
```kconfig
menu "QMC5883L Options"
    config QMC5883L_I2C_CLK_SPEED_HZ
        int "I2C Clock Speed (Hz)"
        default 100000
        range 1000 100000
        help
            Set the I2C clock speed in Hz. Only applies to the new I2C Master driver.

    config QMC5883L_TIMEOUT
        int "Read/Write Timeout"
        default 50
        help
            Number of ticks to wait for I2C read/write operations.
endmenu
```

## components/tlv493/Kconfig
```kconfig
menu "TLV493 Options"
    config TLV493_I2C_CLK_SPEED_HZ
        int "I2C Clock Speed (Hz)"
        default 100000
        range 1000 100000
        help
            Set the I2C clock speed in Hz. Only applies to the new I2C Master driver.

    config TLV493_PROBE_TIMEOUT
        int "Probe Timeout"
        default 500
        help
            Number of ticks to wait for I2C probe operation.
        
    config TLV493_TIMEOUT
        int "Read/Write Timeout"
        default 50
        help
            Number of ticks to wait for I2C read/write operations.
endmenu
```

## components/wifi/Kconfig
```kconfig
menu "WiFi Setting"

	choice WIFI_MODE
		prompt "Wi-Fi Access mode"
		default ST_MODE
		help
			Select Wi-Fi Access mode.
		config ST_MODE
			bool "Station MODE"
			help
				Wi-Fi is Station Mode.
		config AP_MODE
			bool "Access Point MODE"
			help
				Wi-Fi is Access Point Mode.
	endchoice

	config ESP_WIFI_ST_SSID
		depends on ST_MODE
		string "WiFi SSID"
		default "myssid"
		help
			SSID (network name) to connect to.

	config ESP_WIFI_ST_PASSWORD
		depends on ST_MODE
		string "WiFi Password"
		default "mypassword"
		help
			WiFi password (WPA or WPA2) to connect to.

	config ESP_WIFI_AP_SSID
		depends on AP_MODE
		string "WiFi SSID"
		default "esp32"
		help
			SSID (network name) to connect to.

	config ESP_WIFI_AP_PASSWORD
		depends on AP_MODE
		string "WiFi Password"
		default "password"
		help
			WiFi password (WPA or WPA2) to connect to.

	config ESP_MAX_STA_CONN
		depends on AP_MODE
		int "Maximum STA connections"
		default 4
		help
			Max number of the STA connects to AP.

	config ESP_MAXIMUM_RETRY
		depends on ST_MODE
		int "Maximum retry"
		default 5
		help
			Set the Maximum retry to avoid station reconnecting to the AP unlimited when the AP is really inexistent.

	config MDNS_HOSTNAME
		depends on ST_MODE
		string "mDNS Hostname"
		default "ftp-server"
		help
			mDNS Hostname for FTP Server.

	config STATIC_IP
		depends on ST_MODE
		bool "Enable Static IP Address"
		default false
		help
			Enable Static IP Address.

	config STATIC_IP_ADDRESS
		depends on STATIC_IP
		string "Static IP Address"
		default "192.168.10.100"
		help
			Static IP Address for Station.

	config STATIC_GW_ADDRESS
		depends on STATIC_IP
		string "Static GW Address"
		default "192.168.10.1"
		help
			Static GW Address for Station.

	config STATIC_NM_ADDRESS
		depends on STATIC_IP
		string "Static Netmask"
		default "255.255.255.0"
		help
			Static Netmask for Statione.

	config NTP_SERVER
		depends on ST_MODE
		string "NTP Server"
		default "pool.ntp.org"
		help
			Hostname for NTP Server.

	config LOCAL_TIMEZONE
		depends on ST_MODE
		int "Your TimeZone"
		range -23 23
		default 0
		help
			Your local timezone. When it is 0, Greenwich Mean Time.

endmenu
```

## main/Kconfig
```kconfig
menu "I2C Options"
    choice I2C_DRIVER_SETTING
        prompt "I2C driver setting"
        help
            Select I2C Driver: I2C Legacy Driver: I2C.h , I2C Master Driver i2c_master.h for ESP-IDF >= 5.3 AND Set I2C Clock Speed.
        default USE_I2C_LEGACY_DRIVER
        config USE_I2C_LEGACY_DRIVER
            bool "I2C Legacy Driver (I2C.h)"
            help
                Use I2C Legacy Driver (I2C.h).
        config USE_I2C_MASTER_DRIVER
            bool "I2C Master Driver (i2c_master.h)"
            help
                Use I2C Master Driver (i2c_master.h) for ESP-IDF >= 5.3.
    endchoice
endmenu
```
